## boards/CobaltDesign/CustomSeeedNRF52840/Kconfig.defconfig
```kconfig
if BOARD_CUSTOMSEEEDNRF52840

config BT_CTLR
	default BT

endif # BOARD_CUSTOMSEEEDNRF52840
```

## boards/CobaltDesign/CustomSeeedNRF52840/board.yml
```yaml
board:
  name: CustomSeeedNRF52840
  vendor: CobaltDesign
  socs:
    - name: nrf52840
```
